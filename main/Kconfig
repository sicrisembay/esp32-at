## main/Kconfig
```kconfig
menu "AT"

config AT_ENABLE
    bool "Enable AT"
    default "y"


choice AT_COMMUNICATION_METHOD
    prompt "communicate method for AT command"
    default AT_BASE_ON_UART
    depends on AT_ENABLE

source "$ESP_AT_PROJECT_PATH/main/interface/uart/Kconfig"
source "$ESP_AT_PROJECT_PATH/main/interface/hspi/Kconfig"
endchoice

config AT_COMMAND_TERMINATOR_SUPPORT
    bool "AT command terminator support."
    default "n"
    depends on AT_ENABLE

config AT_COMMAND_TERMINATOR
    hex "AT command terminator. "
    help 
        Now just support one character, the range is from 0x01 to 0xFF.
    range 0x01 0xFF
    default 0x0A
    depends on AT_COMMAND_TERMINATOR_SUPPORT

config AT_BASE_COMMAND_SUPPORT
    bool "AT base command support."
    default "y"
    depends on AT_ENABLE

config AT_WIFI_COMMAND_SUPPORT
    bool "AT wifi command support."
    default "y"
    depends on AT_ENABLE

config AT_NET_COMMAND_SUPPORT
    bool "AT net command support."
    default "y"
    depends on AT_WIFI_COMMAND_SUPPORT
    
config AT_BLE_COMMAND_SUPPORT
    bool "AT ble command support."
    default "y"
    depends on AT_ENABLE
    
config AT_FS_COMMAND_SUPPORT
    bool "AT FS command support."
    default "n"
    depends on AT_ENABLE
    select WL_SECTOR_SIZE_512
    select FATFS_LFN_HEAP
    
config AT_OTA_SERVER_IP
    string "Server IP for AT OTA."
    default "iot.espressif.cn"
    depends on AT_ENABLE

config AT_OTA_SERVER_PORT
    int "Server port for AT OTA."
    default 80
    depends on AT_ENABLE

config AT_OTA_TOKEN_KEY
    string "The token for AT OTA."
    default "dd93253c287f725de50d4071a05dd28b72056ca7"
    depends on AT_ENABLE

config AT_OTA_SSL_SUPPORT
    bool "OTA based upon ssl"
    default "y"
    depends on AT_ENABLE

config AT_OTA_SSL_SERVER_IP
    string "SSL server IP for AT OTA."
    default "iot.espressif.cn"
    depends on AT_OTA_SSL_SUPPORT

config AT_OTA_SSL_SERVER_PORT
    int "SSL server port for AT ssl OTA."
    default 443
    depends on AT_OTA_SSL_SUPPORT

config AT_OTA_SSL_TOKEN_KEY
    string "The SSL token for AT OTA."
    default "dd93253c287f725de50d4071a05dd28b72056ca7"
    depends on AT_OTA_SSL_SUPPORT

config ESP_AT_FW_VERSION
    string "AT firmware version."
    depends on AT_ENABLE
    help
      The maximum length of the string is 128 characters.
      If more than 128 characters, it will be invalid.

endmenu

menu "BT_ZPL_BRIDGE"
menu "Bridge UART Settings"
config BRIDGE_UART_PORT
    int "uart port number for bridge"
    default 2
    range 0 2
    
config BRIDGE_UART_PORT_TX_PIN
    int "uart tx pin for bridge"
    default 12
    
config BRIDGE_UART_PORT_RX_PIN
    int "uart rx pin for bridge"
    default 13
    
config BRIDGE_UART_BAUDRATE
    int "uart baud rate for bridge"
    default 115200
    range 80 5000000
    
endmenu

menu "Buffer Settings"
config BRIDGE_TX_BUFF_SIZE
    int "Number of bytes allocated for transmit buffer"
    default 512
    
config BRIDGE_RX_BUFF_SIZE
    int "Number of bytes allocated for receive buffer"
    default 1024
endmenu

menu "Bridge Task Settings"
menu "Tx Task"
    choice BRIDGE_TX_PINNED_TO_CORE_CHOICE
        prompt "The cpu core which this task run"
        depends on !FREERTOS_UNICORE
        help
          Specify the cpu core to run this task.
        config BRIDGE_TX_TASK_PINNED_TO_CORE_0
          bool "Core 0 (PRO CPU)"
        config BRIDGE_TX_TASK_PINNED_TO_CORE_1
          bool "Core 1 (APP CPU)"
        config BRIDGE_TX_TASK_NO_CORE_AFFINITY
          bool "No Affinity (PRO or APP CPU)"
        depends on !FREERTOS_UNICORE
    endchoice
    
config BRIDGE_TX_TASK_STACK_SIZE
    int "Stack Size allocated for Bridge TX Task"
    default 2048
    
config BRIDGE_TX_TASK_PRIORITY
    int "Priority of Bridge TX Task"
    default 5

endmenu

menu "Rx Task"
    choice BRIDGE_RX_PINNED_TO_CORE_CHOICE
        prompt "The cpu core which this task run"
        depends on !FREERTOS_UNICORE
        help
          Specify the cpu core to run this task.
        config BRIDGE_RX_TASK_PINNED_TO_CORE_0
          bool "Core 0 (PRO CPU)"
        config BRIDGE_RX_TASK_PINNED_TO_CORE_1
          bool "Core 1 (APP CPU)"
        config BRIDGE_RX_TASK_NO_CORE_AFFINITY
          bool "No Affinity (PRO or APP CPU)"
        depends on !FREERTOS_UNICORE
    endchoice
    
config BRIDGE_RX_TASK_STACK_SIZE
    int "Stack Size allocated for Bridge RX Task"
    default 2048
    
config BRIDGE_RX_TASK_PRIORITY
    int "Priority of Bridge TX Task"
    default 4

endmenu #"Rx Task"

endmenu

endmenu
```
